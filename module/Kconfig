## module/Kconfig
```kconfig
menu "Van Gogh APU OC Fix"

config HEADERS_HAVE_EXTRA_SHIT
    bool
    help
      Set if you are using jupiter-main with linux-neptune-61 otherwise the headers are off.
```
